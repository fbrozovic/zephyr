## boards/arm/nucleo_h743zi/Kconfig.board
```kconfig
# STM32H743ZI Nucleo board configuration

# Copyright (c) 2019 SEAL AG
# SPDX-License-Identifier: Apache-2.0

config BOARD_NUCLEO_H743ZI
	bool "Nucleo H743ZI Development Board"
	depends on SOC_STM32H743XX
```

## boards/arm/nucleo_h743zi/Kconfig.defconfig
```kconfig
# STM32H743ZI Nucleo board configuration

# Copyright (c) 2019 SEAL AG
# SPDX-License-Identifier: Apache-2.0

if BOARD_NUCLEO_H743ZI

config BOARD
	default "nucleo_h743zi"

# clock configuration
config SYS_CLOCK_HW_CYCLES_PER_SEC
	default 480000000

config CLOCK_STM32_D1CPRE
	default 1

config CLOCK_STM32_HPRE
	# HCLK: 240MHz
	default 2

config CLOCK_STM32_D2PPRE1
	# APBX: 120MHz
	default 2

config CLOCK_STM32_D2PPRE2
	default 2

config CLOCK_STM32_D1PPRE
	default 2

config CLOCK_STM32_D3PPRE
	default 2

if UART_CONSOLE

config UART_3
	default y

endif # UART_CONSOLE

endif # BOARD_NUCLEO_H743ZI
```

## boards/arm/nucleo_h743zi/nucleo_h743zi_defconfig
```kconfig
# SPDX-License-Identifier: Apache-2.0

CONFIG_ARM=y
CONFIG_BOARD_NUCLEO_H743ZI=y
CONFIG_SOC_SERIES_STM32H7X=y
CONFIG_SOC_STM32H743XX=y

# Enable MPU
CONFIG_ARM_MPU=y

# Serial Drivers
CONFIG_SERIAL=y
CONFIG_UART_INTERRUPT_DRIVEN=y
CONFIG_CONSOLE=y
CONFIG_UART_CONSOLE=y

# enable pinmux
CONFIG_PINMUX=y

# enable GPIO
CONFIG_GPIO=y

# clock configuration
CONFIG_CLOCK_CONTROL=y
# SYSCLK selection
CONFIG_CLOCK_STM32_SYSCLK_SRC_PLL=y
# use HSI as PLL input
CONFIG_CLOCK_STM32_PLL_SRC_HSI=y
# produce 480MHz clock at PLL output
CONFIG_CLOCK_STM32_PLL_M_DIVISOR=8
CONFIG_CLOCK_STM32_PLL_N_MULTIPLIER=120
CONFIG_CLOCK_STM32_PLL_P_DIVISOR=2
CONFIG_CLOCK_STM32_PLL_Q_DIVISOR=4
CONFIG_CLOCK_STM32_PLL_R_DIVISOR=2
```

## drivers/display/Kconfig.v231
```kconfig
# Kconfig - Configuration options for Pervasive Displays V231 display

#
# Copyright (c) 2019 Filip Brozovic <fbrozovic@gmail.com>
#
# SPDX-License-Identifier: Apache-2.0
#

menuconfig V231
	bool "Pervasive Displays V231 display driver"
	help
	  Enable V231 display driver compliant with display driver API.

if V231

config V231_POOL_BLOCK_NUM
	int "Number of memory pool blocks"
	default 1
	help
	  Number of blocks in the frame buffer memory pool.

config V231_POOL_BLOCK_MIN
	hex "Minimum memory pool block size"
	default 64
	help
	  Minimum block size in the frame buffer memory pool.

config V231_POOL_BLOCK_MAX
	hex "Maximum memory pool block size"
	default 4096
	help
	  Maximum block size in the frame buffer memory pool.

config V231_POOL_BLOCK_ALIGN
	int "Alignment of memory pool blocks"
	default 64
	help
	  Byte alignment in the frame buffer memory pool.

endif #V231
```

## dts/bindings/display/pervasive,v231.yaml
```yaml
#
# Copyright (c) 2019 Filip Brozovic <fbrozovic@gmail.com>
#
# SPDX-License-Identifier: Apache-2.0
#
---
title: V231 eInk Display Controller
version: 0.1

description: >
    This is a representation of the V231 eInk Display Controller

inherits:
    !include spi-device.yaml

properties:
    compatible:
      constraint: "pervasive,v231"

    height:
      type: int
      category: required
      description: Height in pixel of the panel driven by the controller
      generation: define

    width:
      type: int
      category: required
      description: Width in pixel of the panel driven by the controller
      generation: define

    reset-gpios:
      type: compound
      category: required
      generation: define, use-prop-name

    cmd-data-gpios:
      type: compound
      category: required
      generation: define, use-prop-name

    busy-gpios:
      type: compound
      category: required
      generation: define, use-prop-name

    enable-gpios:
      type: compound
      category: required
      generation: define, use-prop-name

    bs-gpios:
      type: compound
      category: optional
      generation: define, use-prop-name

    orientation:
      type: int
      category: optional
      generation: define, use-prop-name

...
```

## soc/arm/st_stm32/stm32h7/Kconfig.defconfig.stm32h743xx
```kconfig
# STMicroelectronics STM32H743xx MCU

# Copyright (c) 2019 SEAL AG
# SPDX-License-Identifier: Apache-2.0

if SOC_STM32H743XX

config SOC
	default "stm32h743xx"

config NUM_IRQS
	default 150

config CPU_CORTEX_M7
	default y

endif # SOC_STM32H743XX
```
